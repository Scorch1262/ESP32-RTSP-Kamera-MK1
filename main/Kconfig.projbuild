## main/Kconfig.projbuild
```kconfig
menu "P4-ETH-RTSP-Cam-MK1"

    menu "Ethernet"
        choice APP_ETH_PHY
            prompt "Ethernet-PHY"
            depends on IDF_TARGET_ESP32P4
            default APP_ETH_PHY_IP101
            config APP_ETH_PHY_IP101
                bool "IP101 (Standard bei Waveshare ESP32-P4-Boards)"
            config APP_ETH_PHY_GENERIC
                bool "Generischer IEEE-802.3-PHY"
        endchoice

        config APP_ETH_PHY_ADDR
            int "PHY-Adresse"
            depends on IDF_TARGET_ESP32P4
            range -1 31
            default 1
            help
                -1 = automatische Suche.

        config APP_ETH_PHY_RST_GPIO
            int "PHY-Reset-GPIO"
            depends on IDF_TARGET_ESP32P4
            range -1 54
            default 51

        config APP_ETH_MDC_GPIO
            int "SMI MDC GPIO"
            depends on IDF_TARGET_ESP32P4
            default 31

        config APP_ETH_MDIO_GPIO
            int "SMI MDIO GPIO"
            depends on IDF_TARGET_ESP32P4
            default 52

        config APP_W5500_SPI_MHZ
            int "W5500 SPI-Takt (MHz)"
            depends on IDF_TARGET_ESP32S3
            range 8 80
            default 36

        config APP_W5500_MOSI
            int "W5500 MOSI"
            depends on IDF_TARGET_ESP32S3
            default 11
        config APP_W5500_MISO
            int "W5500 MISO"
            depends on IDF_TARGET_ESP32S3
            default 12
        config APP_W5500_SCLK
            int "W5500 SCLK"
            depends on IDF_TARGET_ESP32S3
            default 13
        config APP_W5500_CS
            int "W5500 CS"
            depends on IDF_TARGET_ESP32S3
            default 14
        config APP_W5500_INT
            int "W5500 INT"
            depends on IDF_TARGET_ESP32S3
            default 10
        config APP_W5500_RST
            int "W5500 RST"
            depends on IDF_TARGET_ESP32S3
            default 9

        config APP_HOSTNAME
            string "Hostname"
            default "p4-rtsp-cam"

        config APP_USE_STATIC_IP
            bool "Statische IP-Adresse statt DHCP"
            default n

        config APP_STATIC_IP
            string "IP-Adresse"
            depends on APP_USE_STATIC_IP
            default "192.168.1.60"

        config APP_STATIC_NETMASK
            string "Netzmaske"
            depends on APP_USE_STATIC_IP
            default "255.255.255.0"

        config APP_STATIC_GW
            string "Gateway"
            depends on APP_USE_STATIC_IP
            default "192.168.1.1"
    endmenu

    menu "Kamera (OV5640, MIPI-CSI) - ESP32-P4"
        depends on IDF_TARGET_ESP32P4
        config APP_CAM_SCCB_PORT
            int "SCCB/I2C-Port"
            default 0

        config APP_CAM_SCCB_SCL_GPIO
            int "SCCB SCL GPIO"
            default 8

        config APP_CAM_SCCB_SDA_GPIO
            int "SCCB SDA GPIO"
            default 7

        config APP_CAM_SCCB_FREQ
            int "SCCB-Takt (Hz)"
            default 100000

        config APP_CAM_RESET_GPIO
            int "Sensor-Reset-GPIO (-1 = keiner)"
            default -1

        config APP_CAM_PWDN_GPIO
            int "Sensor-Powerdown-GPIO (-1 = keiner)"
            default -1

        config APP_CAM_FPS
            int "Bildrate des Sensors (fps, fuer Encoder-Ratensteuerung)"
            range 1 60
            default 14
            help
                Der OV5640-Treiber liefert ueber MIPI-CSI 1280x720 bei 14 fps.
    endmenu

    menu "H.264-Encoder - ESP32-P4"
        depends on IDF_TARGET_ESP32P4
        config APP_H264_BITRATE
            int "Ziel-Bitrate (bit/s)"
            range 100000 20000000
            default 2500000

        config APP_H264_GOP
            int "GOP-Laenge (Abstand der IDR-Frames)"
            range 1 255
            default 28

        config APP_H264_QP_MIN
            int "QP minimal"
            range 0 51
            default 20

        config APP_H264_QP_MAX
            int "QP maximal"
            range 0 51
            default 38
    endmenu

    menu "Kamera (OV5640/OV2640, DVP, MJPEG) - ESP32-S3"
        depends on IDF_TARGET_ESP32S3

        config APP_S3_CAM_WIDTH
            int "Standard-Aufloesung (640, 800, 1024, 1280=HD, 1281=SXGA, 1600, 1920)"
            default 1280
            help
                1280 = HD 1280x720, 1600 = 1600x1200, 1920 = Full HD 1920x1080.
                Spaeter auf der Webseite aenderbar.

        config APP_S3_JPEG_QUALITY
            int "JPEG-Qualitaet (4 = beste, 40 = schlechteste)"
            range 4 40
            default 12

        config APP_S3_CAM_XCLK_HZ
            int "XCLK-Frequenz (Hz)"
            default 20000000

        config APP_S3_CAM_VFLIP
            bool "Bild vertikal spiegeln (OV5640)"
            default n
        config APP_S3_CAM_HMIRROR
            bool "Bild horizontal spiegeln (OV5640)"
            default n

        config APP_S3_CAM_PWDN
            int "Kamera-Versorgung (Waveshare: GPIO8, Low = ein)"
            default 8
        config APP_S3_CAM_XCLK
            int "XCLK"
            default 3
        config APP_S3_CAM_SDA
            int "SIOD (SDA)"
            default 48
        config APP_S3_CAM_SCL
            int "SIOC (SCL)"
            default 47
        config APP_S3_CAM_D0
            int "D0"
            default 41
        config APP_S3_CAM_D1
            int "D1"
            default 45
        config APP_S3_CAM_D2
            int "D2"
            default 46
        config APP_S3_CAM_D3
            int "D3"
            default 42
        config APP_S3_CAM_D4
            int "D4"
            default 40
        config APP_S3_CAM_D5
            int "D5"
            default 38
        config APP_S3_CAM_D6
            int "D6"
            default 15
        config APP_S3_CAM_D7
            int "D7"
            default 18
        config APP_S3_CAM_VSYNC
            int "VSYNC"
            default 1
        config APP_S3_CAM_HREF
            int "HREF"
            default 2
        config APP_S3_CAM_PCLK
            int "PCLK"
            default 39
    endmenu

    menu "RTSP-Server"
        config APP_RTSP_PORT
            int "RTSP-Port"
            range 1 65535
            default 554

        config APP_RTSP_PATH
            string "Stream-Pfad"
            default "stream"
            help
                URL: rtsp://<IP>:<Port>/<Pfad>

        config APP_RTSP_MAX_CLIENTS
            int "Maximale gleichzeitige Clients"
            range 1 8
            default 4

        config APP_RTP_MAX_PAYLOAD
            int "Maximale RTP-Nutzlast (Byte)"
            range 500 1460
            default 1400
    endmenu

    menu "MQTT / IR-Beleuchtung (Startwerte, spaeter per Webseite aenderbar)"
        config APP_MQTT_URI
            string "MQTT-Broker-URI (leer = aus)"
            default ""
            help
                z. B. mqtt://192.168.1.10:1883

        config APP_MQTT_TOPIC
            string "Schalt-Topic der IR-Beleuchtung (Nutzlast 0/1)"
            default "Tuer/Kamera"

        config APP_IR_GPIO
            int "GPIO der IR-Beleuchtung (-1 = aus)"
            range -1 54
            default 17 if IDF_TARGET_ESP32S3
            default 20

        config APP_IR_ACTIVE_LOW
            bool "Ausgang Low-aktiv (Low = Beleuchtung ein)"
            default n
    endmenu

endmenu
```

## sdkconfig.defaults.esp32p4
```kconfig
# --- ESP32-P4 (Waveshare ESP32-P4-ETH) --------------------------------------
CONFIG_SPIRAM_SPEED_200M=y
CONFIG_IDF_EXPERIMENTAL_FEATURES=y

# Kamera: OV5640 an MIPI-CSI
CONFIG_CAMERA_OV5640=y
CONFIG_CAMERA_OV5640_AUTO_DETECT_MIPI_INTERFACE_SENSOR=y
CONFIG_ESP_VIDEO_ENABLE_MIPI_CSI_VIDEO_DEVICE=y
# DVP-, SPI- und USB-Kameras werden nicht gebraucht
CONFIG_ESP_VIDEO_ENABLE_DVP_VIDEO_DEVICE=n
CONFIG_ESP_VIDEO_ENABLE_SPI_VIDEO_DEVICE=n
CONFIG_ESP_VIDEO_ENABLE_USB_UVC_VIDEO_DEVICE=n

# Ethernet: interne EMAC
CONFIG_ETH_USE_ESP32_EMAC=y
CONFIG_ETH_DMA_TX_BUFFER_NUM=20
CONFIG_ETH_DMA_RX_BUFFER_NUM=20
```
